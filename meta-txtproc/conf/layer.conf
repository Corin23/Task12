## meta-txtproc/conf/layer.conf
```bitbake
# We have a conf and classes directory, add to BBPATH 

BBPATH := "${BBPATH}:${LAYERDIR}"
 
# We have a packages directory, add to BBFILES 

BBFILES := "${BBFILES} ${LAYERDIR}/recipes-*/*/*.bb \ 
            ${LAYERDIR}/recipes-*/*/*.bbappend" 

BBFILE_COLLECTIONS += "txtproc" 
BBFILE_PATTERN_txtproc:= "^${LAYERDIR}/" 
BBFILE_PRIORITY_txtproc:= "5"
LAYERSERIES_COMPAT_txtproc := "kirkstone"
```
